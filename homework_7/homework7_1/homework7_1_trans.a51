;TRANSMIT
ORG 0000H
	LJMP MAIN
ORG 1000H
MAIN:
	CLR EA
	MOV TCON, #20H       ;SET T1
	MOV TL1, #0FAH
	MOV TH1, #0FAH
	SETB TR1
	SETB ES
    MOV  PCON,#00H       ;SET UART
    MOV  SCON,#50H
	MOV P1,#00H
	READ:

    MOV P2, #0FFH            ;READ IN KEYBOARD
	CLR P2.3
	JNB P2.2, NUM1
	JNB P2.1, NUM2
	JNB P2.0, NUM3
	SETB P2.3
	CLR P2.4
	JNB P2.2, NUM4
	JNB P2.1, NUM5
	JNB P2.0, NUM6
	SETB P2.4
	CLR P2.5
	JNB P2.2, NUM7
	JNB P2.1, NUM8
	JNB P2.0, NUM9
	SETB P2.5
	CLR P2.6
	JNB P2.1, NUM0
	SETB P2.6
	SJMP READ
	NUM0:
	MOV A,#3FH
	SJMP SEND
	NUM1:
	MOV A,#06H
	SJMP SEND	
	NUM2:
	MOV A,#5BH
	SJMP SEND
	NUM3:
	MOV A,#4FH
	SJMP SEND
	NUM4:
	MOV A,#66H
	SJMP SEND
	NUM5:
	MOV A,#6DH
	SJMP SEND
	NUM6:
	MOV A,#7DH
	SJMP SEND
	NUM7:
	MOV A,#07H
	SJMP SEND
	NUM8:
	MOV A,#7FH
	SJMP SEND
	NUM9:
	MOV A,#6FH
	SJMP SEND
	SEND:     ;TRANSMIT

	JNB P0.0,READ
	MOV SBUF,A			;UART TRANS
	
    JNB  TI,$ 			;WAIT FOR TRANS
    CLR  TI				;OPEN RE-TRANS
	MOV P1,#0FH	
	LJMP READ
END
